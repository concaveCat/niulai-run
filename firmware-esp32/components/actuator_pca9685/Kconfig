## firmware-esp32/components/actuator_pca9685/Kconfig
```kconfig
menu "牛来快跑 PCA9685"

    config NIULAI_PCA9685_SDA_PIN
        int "I2C SDA GPIO"
        range 0 48
        default 11

    config NIULAI_PCA9685_SCL_PIN
        int "I2C SCL GPIO"
        range 0 48
        default 12

    config NIULAI_PCA9685_OE_PIN
        int "/OE GPIO (active low, 10k pull-up)"
        range 0 48
        default 1

    config NIULAI_PCA9685_I2C_ADDR
        hex "PCA9685 I2C address"
        range 0x00 0x7F
        default 0x40

    config NIULAI_PCA9685_I2C_TIMEOUT_MS
        int "PCA9685 I2C transaction timeout (ms)"
        range 1 1000
        default 50
        help
            Every PCA9685 transaction is bounded by this timeout. A timeout
            must leave the safety gate able to assert /OE and report a
            latched actuator fault.

    config NIULAI_PCA9685_PWM_FREQ_HZ
        int "PWM frequency (Hz)"
        range 24 1526
        default 50

    comment "Formal four-leg calibration (FL/FR/RL/RR semantic order)"

    config NIULAI_FORMAL_FL_HIP_REST_US
        int "FL hip rest pulse (us)"
        range 500 2500
        default 1672

    config NIULAI_FORMAL_FL_KNEE_REST_US
        int "FL knee rest pulse (us)"
        range 500 2500
        default 1748

    config NIULAI_FORMAL_FR_HIP_REST_US
        int "FR hip rest pulse (us)"
        range 500 2500
        default 1494

    config NIULAI_FORMAL_FR_KNEE_REST_US
        int "FR knee rest pulse (us)"
        range 500 2500
        default 1165

    config NIULAI_FORMAL_RL_HIP_REST_US
        int "RL hip rest pulse (us)"
        range 500 2500
        default 1764

    config NIULAI_FORMAL_RL_KNEE_REST_US
        int "RL knee rest pulse (us)"
        range 500 2500
        default 1934

    config NIULAI_FORMAL_RR_HIP_REST_US
        int "RR hip rest pulse (us)"
        range 500 2500
        default 1368

    config NIULAI_FORMAL_RR_KNEE_REST_US
        int "RR knee rest pulse (us)"
        range 500 2500
        default 1279

    comment "Formal per-channel mechanical pulse envelope"

    config NIULAI_FORMAL_CH0_MIN_US
        int "CH0 minimum pulse (us)"
        range 500 2500
        default 1400
        help
            This cannot widen the current hard safety envelope. Recalibration
            requires changing the reviewed source defaults and repeating the
            hardware safety review.

    config NIULAI_FORMAL_CH0_MAX_US
        int "CH0 maximum pulse (us)"
        range 500 2500
        default 2500

    config NIULAI_FORMAL_CH1_MIN_US
        int "CH1 minimum pulse (us)"
        range 500 2500
        default 500

    config NIULAI_FORMAL_CH1_MAX_US
        int "CH1 maximum pulse (us)"
        range 500 2500
        default 2500

    config NIULAI_FORMAL_CH2_MIN_US
        int "CH2 minimum pulse (us)"
        range 500 2500
        default 500

    config NIULAI_FORMAL_CH2_MAX_US
        int "CH2 maximum pulse (us)"
        range 500 2500
        default 1750

    config NIULAI_FORMAL_CH3_MIN_US
        int "CH3 minimum pulse (us)"
        range 500 2500
        default 500

    config NIULAI_FORMAL_CH3_MAX_US
        int "CH3 maximum pulse (us)"
        range 500 2500
        default 2500

    config NIULAI_FORMAL_CH4_MIN_US
        int "CH4 minimum pulse (us)"
        range 500 2500
        default 500

    config NIULAI_FORMAL_CH4_MAX_US
        int "CH4 maximum pulse (us)"
        range 500 2500
        default 1940

    config NIULAI_FORMAL_CH5_MIN_US
        int "CH5 minimum pulse (us)"
        range 500 2500
        default 500

    config NIULAI_FORMAL_CH5_MAX_US
        int "CH5 maximum pulse (us)"
        range 500 2500
        default 2500

    config NIULAI_FORMAL_CH6_MIN_US
        int "CH6 minimum pulse (us)"
        range 500 2500
        default 1120

    config NIULAI_FORMAL_CH6_MAX_US
        int "CH6 maximum pulse (us)"
        range 500 2500
        default 2500

    config NIULAI_FORMAL_CH7_MIN_US
        int "CH7 minimum pulse (us)"
        range 500 2500
        default 500

    config NIULAI_FORMAL_CH7_MAX_US
        int "CH7 maximum pulse (us)"
        range 500 2500
        default 2500

    config NIULAI_FORMAL_MAX_PULSE_STEP_US
        int "Formal maximum per-frame pulse step (us)"
        range 1 1000
        default 250

    config NIULAI_SERVO_MAX_VELOCITY_US_S
        int "Per-servo interpolation velocity limit (us/s)"
        range 100 10000
        default 900
        help
            Maximum pulse-width slew rate used by the actuator adapter.
            This is an experimental safety/feel parameter, not a servo spec.

    config NIULAI_SERVO_MAX_ACCELERATION_US_S2
        int "Per-servo interpolation acceleration limit (us/s^2)"
        range 100 100000
        default 3600
        help
            Acceleration/deceleration bound for online target interpolation.

    comment "Pose mapping (EXP-001 bench-tuning candidates, not final specs)"

    config NIULAI_PCA9685_PULSE_HOLD_US
        int "hold_support pulse width (us)"
        range 500 2500
        default 1500

    config NIULAI_PCA9685_PULSE_LIFT_US
        int "lift pose pulse width A (us)"
        range 500 2500
        default 1200

    config NIULAI_PCA9685_PULSE_LIFT_B_US
        int "lift pose pulse width B (us)"
        range 500 2500
        default 1700

    config NIULAI_PCA9685_PULSE_SWING_AMPLITUDE_US
        int "swing amplitude about the lift pose (us)"
        range 0 1000
        default 300

    config NIULAI_PCA9685_PULSE_SEARCH_A_US
        int "search pulse width A (us)"
        range 500 2500
        default 1000

    config NIULAI_PCA9685_PULSE_SEARCH_B_US
        int "search pulse width B (us)"
        range 500 2500
        default 1800

endmenu
```

## firmware-esp32/components/foot_contact/Kconfig
```kconfig
menu "牛来快跑 Foot Contact"

    # Operator mapping: GPIO39=FR, GPIO40=FL, GPIO41=RR, GPIO42=RL.

    config NIULAI_CONTACT_PIN_FL
        int "FL foot contact GPIO"
        range -1 48
        default 40

    config NIULAI_CONTACT_PIN_FR
        int "FR foot contact GPIO"
        range -1 48
        default 39

    config NIULAI_CONTACT_PIN_RL
        int "RL foot contact GPIO"
        range -1 48
        default 42

    config NIULAI_CONTACT_PIN_RR
        int "RR foot contact GPIO"
        range -1 48
        default 41

endmenu
```
